## samples/bluetooth/eddystone/sample.yaml
```yaml
sample:
  name: Bluetooth Eddystone
tests:
  sample.bluetooth.eddystone:
    harness: bluetooth
    platform_allow: qemu_cortex_m3 qemu_x86 nrf52840dk_nrf52840
    tags: bluetooth
```

## samples/bluetooth/ibeacon/sample.yaml
```yaml
sample:
  description: Sample code for Zephyr iBeacon Demo
  name: iBeacon
tests:
  sample.bluetooth.ibeacon:
    harness: bluetooth
    platform_allow: bbc_microbit qemu_x86 nrf52840dk_nrf52840
    tags: bluetooth
```
